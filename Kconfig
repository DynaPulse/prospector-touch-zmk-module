## Kconfig
```kconfig
# Prospector Touch — touch-enabled USB dongle module

config PROSPECTOR_TOUCH
    bool "Prospector Touch hybrid module"
    default y if SHIELD_PROSPECTOR_TOUCH
    select LVGL if ZMK_DISPLAY

if PROSPECTOR_TOUCH

config PROSPECTOR_TOUCH_ENABLED
    bool "Enable CST816S capacitive touch + swipe gestures"
    default y
    select INPUT
    select INPUT_CST816S
    select INPUT_CST816S_INTERRUPT
    help
      Uses the upstream Zephyr CST816S input driver (compatible
      "hynitron,cst816s"). The display UI reads INPUT_ABS_X/Y + INPUT_BTN_TOUCH
      directly via an input callback and derives swipe/tap gestures that drive
      page navigation, layout, channel and brightness in both modes.

config PROSPECTOR_USE_AMBIENT_LIGHT_SENSOR
    bool "Auto-brightness via APDS9960 ambient light sensor"
    default y
    select SENSOR
    select APDS9960

config PROSPECTOR_FIXED_BRIGHTNESS
    int "Fixed backlight brightness when ALS disabled (1-100)"
    range 1 100
    default 60
    depends on !PROSPECTOR_USE_AMBIENT_LIGHT_SENSOR

config PROSPECTOR_DISPLAY_IDLE_S
    int "Seconds of inactivity before the backlight turns off (0 = never)"
    default 60

config PROSPECTOR_DEFAULT_LAYOUT
    int "Default main-screen layout style (0=Dashboard, 1=Focus, 2=Minimal)"
    range 0 2
    default 0

endif # PROSPECTOR_TOUCH
```

## boards/shields/prospector_touch/Kconfig.defconfig
```kconfig
if SHIELD_PROSPECTOR_TOUCH

config ZMK_KEYBOARD_NAME
    default "Prospector"

# --- Display stack (Zephyr 4.1 MIPI DBI + ST7789V) ---
config ZMK_DISPLAY
    default y

config DISPLAY
    default y

config SPI
    default y

config MIPI_DBI
    default y

config ST7789V
    default y

choice ST7789V_PIXEL_FORMAT
    default ST7789V_RGB565
endchoice

choice ZMK_DISPLAY_STATUS_SCREEN
    default ZMK_DISPLAY_STATUS_SCREEN_CUSTOM
endchoice

choice ZMK_DISPLAY_WORK_QUEUE
    default ZMK_DISPLAY_WORK_QUEUE_DEDICATED
endchoice

config ZMK_DISPLAY_DEDICATED_THREAD_STACK_SIZE
    default 16384

# --- LVGL ---
config LV_Z_MEM_POOL_SIZE
    default 32768

config LV_Z_DOUBLE_VDB
    default y

config LV_Z_VDB_SIZE
    default 30

config LV_DPI_DEF
    default 261

config LV_Z_BITS_PER_PIXEL
    default 16

choice LV_COLOR_DEPTH
    default LV_COLOR_DEPTH_16
endchoice

config LV_COLOR_16_SWAP
    default y

# --- Touch + sensors + backlight ---
config INPUT
    default y

config I2C
    default y

config PWM
    default y

config LED
    default y

config PROSPECTOR_USE_AMBIENT_LIGHT_SENSOR
    select SENSOR
    select APDS9960

endif
```

## boards/shields/prospector_touch/Kconfig.shield
```kconfig
config SHIELD_PROSPECTOR_TOUCH
    def_bool $(shields_list_contains,prospector_touch)
```
